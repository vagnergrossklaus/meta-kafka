## conf/layer.conf
```bitbake
# We have a conf and classes directory, add to BBPATH
BBPATH .= ":${LAYERDIR}"

# We have recipes-* directories, add to BBFILES
BBFILES += "${LAYERDIR}/recipes-*/*/*.bb ${LAYERDIR}/recipes-*/*/*.bbappend"

BBFILE_COLLECTIONS += "kafka"
BBFILE_PATTERN_kafka = "^${LAYERDIR}/"
BBFILE_PRIORITY_kafka = "1"

# This should only be incremented on significant changes that will
# cause compatibility issues with other layers
LAYERVERSION_kafka = "1"

LAYERDEPENDS_kafka = "core"

LAYERSERIES_COMPAT_kafka = "dunfell"
```
